## CMakeLists.txt
```
#
# Copyright (c) 2020 Nordic Semiconductor
#
# SPDX-License-Identifier: LicenseRef-Nordic-5-Clause
#

cmake_minimum_required(VERSION 3.13.1)

find_package(Zephyr REQUIRED HINTS $ENV{ZEPHYR_BASE})
project(low_power_uart)

FILE(GLOB app_sources src/*.c)
FILE(GLOB toolkits src/toolkits/*.c)

# NORDIC SDK APP START
target_sources(app PRIVATE
	${app_sources}
	${toolkits}
)

include_directories(inc)
# NORDIC SDK APP END
```

## prj.conf
```kconfig
# Segger RTT debug
CONFIG_UART_CONSOLE=n
CONFIG_LOG=y
CONFIG_CONSOLE=y
CONFIG_EARLY_CONSOLE=y
CONFIG_RTT_CONSOLE=y
CONFIG_USE_SEGGER_RTT=y
CONFIG_LOG_PRINTK=y
CONFIG_LOG_MAX_LEVEL=4
CONFIG_LOG_BACKEND_RTT_MODE_BLOCK=y
```

## inc/app_event_handler.h
```c
#ifndef APP_EVENT_HANDLER_H
#define APP_EVENT_HANDLER_H

#include <logging/log.h>
#include <drivers/uart.h>
#include <sys/util.h>
#include <sys/printk.h>
#include <inttypes.h>
#include <device.h>

#define SLEEP_TIME_MS 100
#define STACKSIZE 1024

extern struct k_msgq my_msgq;

#endif
```

## inc/tk_button.h
```c
#ifndef BUTTON_H
#define BUTTON_H

#include <inttypes.h>
#include <sys/util.h>
#include <zephyr.h>

typedef enum
{
    UP,
    DOWN,
} button_state_t;

typedef enum
{
    HANDLER_NOTHING,
    HANDLER_FIRST_PUSH,
    HANDLER_DOUBLE_PRESS,
    HANDLER_TRIPLE_PRESS,
} cur_action_t;

typedef enum
{
    BUTTON_EVT_SINGLE_PRESS,
    BUTTON_EVT_DOUBLE_PRESS,
    BUTTON_EVT_TRIPLE_PRESS,
    BUTTON_EVT_10SEC_HOLD,
    BUTTON_EVT_30_SEC_HOLD,
} button_event_t;

void button_pressed(const struct device *dev, struct gpio_callback *cb, uint32_t pins);

#endif
```

## inc/tk_gpio.h
```c
#ifndef GPIO_H
#define GPIO_H

#include <drivers/gpio.h>

#define NUMBER_OF_LEDS 4
#define BUTTON_NUM 4
#define SW1_NODE DT_ALIAS(sw1)
#if !DT_NODE_HAS_STATUS(SW1_NODE, okay)
#error "Unsupported board: sw0 devicetree alias is not defined"
#endif

typedef enum
{
    LED1,
    LED2,
    LED3,
    LED4,
    BUTTON,
} leds_t;

void gpio_init();
void switch_all_LEDS(bool value);
void tk_gpio_set(leds_t choosed_led, bool value);
bool tk_gpio_get(leds_t choosed_led);

#endif
```

## src/app_event_handler.c
```c
#include <app_event_handler.h>
#include <tk_gpio.h>
#include <tk_button.h>

LOG_MODULE_REGISTER(app);
struct k_msgq my_msgq;
char __aligned(4) my_msgq_buffer[10 * sizeof(button_event_t)];

K_THREAD_STACK_DEFINE(stack_area, STACKSIZE);
struct k_thread my_thread;

void button_thread()
{
    // button_event_t events;
    button_event_t last;

    while (1)
    {

        if (k_msgq_num_used_get(&my_msgq) > 0)
        {
            k_msgq_get(&my_msgq, &last, K_MSEC(200));
            switch (last)
            {
            case BUTTON_EVT_SINGLE_PRESS:
                tk_gpio_set(LED1, true);
                printk("BUTTON_EVT_SINGLE_PRESS\n");
                break;

            case BUTTON_EVT_DOUBLE_PRESS:
                tk_gpio_set(LED2, true);
                printk("BUTTON_EVT_DOUBLE_PRESS\n");
                break;

            case BUTTON_EVT_TRIPLE_PRESS:
                tk_gpio_set(LED3, true);
                printk("BUTTON_EVT_TRIPLE_PRESS\n");
                break;

            case BUTTON_EVT_10SEC_HOLD:
                tk_gpio_set(LED4, true);
                printk("BUTTON_EVT_10SEC_HOLD\n");
                break;

            case BUTTON_EVT_30_SEC_HOLD:
                switch_all_LEDS(true);
                printk("BUTTON_EVT_30_SEC_HOLD\n");
                break;

            default:
                break;
            }
        }
        else
        {
            switch_all_LEDS(false);
        }

        if (tk_gpio_get(BUTTON))
        {
            printk("Button pushed :) \n Timestamp: %dms\n", k_uptime_get_32());
        }
        k_msleep(SLEEP_TIME_MS);
    }
}

void main(void)
{
    k_msgq_init(&my_msgq, my_msgq_buffer, sizeof(button_event_t), 10);

    gpio_init();

    k_thread_create(&my_thread, stack_area,
                    K_THREAD_STACK_SIZEOF(stack_area),
                    &button_thread,
                    NULL, NULL, NULL,
                    0, 0, K_NO_WAIT);
}
```

## src/tk_button.c
```c
#include <app_event_handler.h>
#include <tk_gpio.h>
#include <tk_button.h>

static cur_action_t action = HANDLER_NOTHING;

static void handle_event(button_event_t button_event);

static void expiry_function_2s()
{
    if (action == HANDLER_DOUBLE_PRESS)
    {
        handle_event(BUTTON_EVT_SINGLE_PRESS);
    }
}

static void expiry_function_3s()
{
    if (action == HANDLER_TRIPLE_PRESS)
    {
        handle_event(BUTTON_EVT_DOUBLE_PRESS);
    }
}

static void expiry_function_10s()
{
    handle_event(BUTTON_EVT_10SEC_HOLD);
}

static void expiry_function_30s()
{
    handle_event(BUTTON_EVT_30_SEC_HOLD);
}

K_TIMER_DEFINE(timer_10s, expiry_function_10s, NULL);
K_TIMER_DEFINE(timer_30s, expiry_function_30s, NULL);
K_TIMER_DEFINE(timer_2s, expiry_function_2s, NULL);
K_TIMER_DEFINE(timer_3s, expiry_function_3s, NULL);

static void handle_event(button_event_t button_event)
{
    action = HANDLER_NOTHING;
    k_timer_stop(&timer_2s);
    k_msgq_put(&my_msgq, &button_event, K_NO_WAIT);
}

static void choose_behaviour(button_state_t button_s)
{
    switch (button_s)
    {
    case DOWN:
        // Timers need to be started up then button is pushed
        k_timer_start(&timer_30s, K_SECONDS(30), K_NO_WAIT);
        k_timer_start(&timer_10s, K_SECONDS(10), K_NO_WAIT);

        if (action == HANDLER_NOTHING)
        {
            action = HANDLER_FIRST_PUSH;

            // Started at since the moment when button is pushed for the first time
            k_timer_start(&timer_2s, K_SECONDS(2), K_MSEC(200));
            k_timer_start(&timer_3s, K_SECONDS(3), K_NO_WAIT);
        }
        break;

    case UP:
        // Timers need to be stopped then button is not pushed
        k_timer_stop(&timer_30s);
        k_timer_stop(&timer_10s);

        switch (action)
        {
        case HANDLER_FIRST_PUSH:
            action = HANDLER_DOUBLE_PRESS;
            break;

        case HANDLER_DOUBLE_PRESS:
            action = HANDLER_TRIPLE_PRESS;
            break;

        case HANDLER_TRIPLE_PRESS:
            k_timer_stop(&timer_3s);
            handle_event(BUTTON_EVT_TRIPLE_PRESS);
            break;

        default:
            // Nothing to do
            break;
        }
        break;

    default:
        // Nothing to do
        break;
    }
}

void button_pressed(const struct device *dev, struct gpio_callback *cb, uint32_t pins)
{
    // For debouncing timing
    static int32_t saved_time = 0;
    // To decide in which position the button is
    static button_state_t button_s = UP;

    // Debouncing feature
    if (k_uptime_get_32() - saved_time > 20)
    {
        saved_time = k_uptime_get_32();
        button_s = !button_s;
        choose_behaviour(button_s);
    }
}
```

## src/tk_gpio.c
```c
#include <tk_gpio.h>
#include <tk_button.h>

static struct gpio_callback button_cb_data;
static struct gpio_dt_spec gpios_t[5] = {
    GPIO_DT_SPEC_GET_OR(DT_ALIAS(led0), gpios, {0}),
    GPIO_DT_SPEC_GET_OR(DT_ALIAS(led1), gpios, {0}),
    GPIO_DT_SPEC_GET_OR(DT_ALIAS(led2), gpios, {0}),
    GPIO_DT_SPEC_GET_OR(DT_ALIAS(led3), gpios, {0}),
    GPIO_DT_SPEC_GET_OR(SW1_NODE, gpios, {0})};

void switch_all_LEDS(bool value)
{
    for (uint8_t i = 0; i < NUMBER_OF_LEDS; i++)
    {
        gpio_pin_set(gpios_t[i].port, gpios_t[i].pin, value);
    }
}

void gpio_init()
{
    /* Make sure button is ready */
    if (!device_is_ready(gpios_t[BUTTON_NUM].port))
    {
        printk("Error: button device %s is not ready\n",
               gpios_t[BUTTON_NUM].port->name);
        return;
    }

    /* Configure button as input */
    int button_ret = gpio_pin_configure_dt(&gpios_t[BUTTON_NUM], GPIO_INPUT);
    if (button_ret)
    {
        printk("Error %d: failed to configure %s pin %d\n", button_ret, gpios_t[BUTTON_NUM].port->name, gpios_t[BUTTON_NUM].pin);
        return;
    }
    else
    {
        printk("Set up Button\n");
    }

    /* Configure button interrupt based on device tree */
    button_ret = gpio_pin_interrupt_configure_dt(&gpios_t[BUTTON_NUM], GPIO_INT_EDGE_BOTH);
    if (button_ret)
    {
        printk("Error %d: failed to configure interrupt on %s pin %d\n", button_ret, gpios_t[BUTTON_NUM].port->name, gpios_t[BUTTON_NUM].pin);
        return;
    }
    else
    {
        gpio_init_callback(&button_cb_data, button_pressed, BIT(gpios_t[BUTTON_NUM].pin));
        gpio_add_callback(gpios_t[BUTTON_NUM].port, &button_cb_data);
    }

    for (uint8_t i = 0; i < NUMBER_OF_LEDS; i++)
    {
        int led_ret = gpio_pin_configure_dt(&gpios_t[i], GPIO_OUTPUT);
        if (led_ret)
        {
            printk("Error %d: failed to configure LED device %s pin %d\n",
                   led_ret, gpios_t[i].port->name, gpios_t[i].pin);
            gpios_t[i].port = NULL;
        }
        else
        {
            printk("Set up LED at %s pin %d\n", gpios_t[i].port->name, gpios_t[i].pin);
        }
    }
}

void tk_gpio_set(leds_t choosed_led, bool value)
{
    gpio_pin_set(gpios_t[choosed_led].port, gpios_t[choosed_led].pin, value);
}

bool tk_gpio_get(leds_t choosedGPIO)
{
    return gpio_pin_get(gpios_t[choosedGPIO].port, gpios_t[choosedGPIO].pin);
}
```
